## boards/arm/actinius_icarus/Kconfig
```kconfig
# Kconfig - Actinius Icarus board configuration
#
# Copyright (c) 2018 Nordic Semiconductor ASA
# Modifications Copyright (c) 2019 Actinius
#
# SPDX-License-Identifier: Apache-2.0

if BOARD_ACTINIUS_ICARUS || BOARD_ACTINIUS_ICARUS_NS

config BOARD_SELECT_SIM_EXTERNAL
        bool "Use external SIM"
	default n
        help
          Use the external SIM for communication, instead of the eSIM

endif # BOARD_ACTINIUS_ICARUS || BOARD_ACTINIUS_ICARUS_NS
```

## boards/arm/actinius_icarus/Kconfig.board
```kconfig
# Kconfig - Actinius Icarus board configuration
#
# Copyright (c) 2018 Nordic Semiconductor ASA
# Modifications Copyright (c) 2019 Actinius
#
# SPDX-License-Identifier: Apache-2.0

if SOC_NRF9160_SICA

config BOARD_ACTINIUS_ICARUS
	bool "Actinius Icarus"
	depends on !TRUSTED_EXECUTION_NONSECURE

config BOARD_ACTINIUS_ICARUS_NS
	bool "Actinius Icarus Non-Secure"
	depends on TRUSTED_EXECUTION_NONSECURE

endif # SOC_NRF9160_SICA
```
